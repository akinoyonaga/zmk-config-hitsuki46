## Kconfig
```kconfig
config HITSUKI46_INPUT_PROCESSOR_TEMP_LAYER_THRESHOLD
    bool "Hitsuki46 threshold-based temporary layer input processor"
    default y
    depends on ZMK_POINTING
    depends on (!ZMK_SPLIT || ZMK_SPLIT_ROLE_CENTRAL)

if HITSUKI46_INPUT_PROCESSOR_TEMP_LAYER_THRESHOLD

config HITSUKI46_INPUT_PROCESSOR_TEMP_LAYER_THRESHOLD_MAX_ACTION_EVENTS
    int "Maximum number of queued layer actions"
    default 16

endif
```

## boards/shields/hitsuki46/Kconfig.defconfig
```kconfig
if SHIELD_HITSUKI46_R

config ZMK_KEYBOARD_NAME
    default "hitsuki46_R"

config ZMK_SPLIT
    default y

config ZMK_SPLIT_ROLE_CENTRAL
    default y

config PAW3222
    default y

endif

if SHIELD_HITSUKI46_L

config ZMK_KEYBOARD_NAME
    default "hitsuki46_L"

config ZMK_SPLIT
    default y

config PAW3222
    default y

endif
```

## config/west.yml
```yaml
# ZMK Config for hitsuki46 - Zephyr 4.1
manifest:
  remotes:
    - name: zmkfirmware
      url-base: https://github.com/zmkfirmware
    - name: sekigon-gonnoc
      url-base: https://github.com/sekigon-gonnoc
    - name: gohanda11
      url-base: https://github.com/gohanda11
#    - name: badjeff
#      url-base: https://github.com/badjeff
    - name: iwk7273
      url-base: https://github.com/iwk7273
    - name: kot149
      url-base: https://github.com/kot149
    - name: hsgw
      url-base: https://github.com/hsgw
    - name: yamaryu211
      url-base: https://github.com/yamaryu211
  projects:
    - name: zmk
      remote: zmkfirmware
      revision: main
      import: app/west.yml
#    - name: zmk-pmw3610-driver
#      remote: badjeff
#      revision: main
    - name: zmk-driver-paw3222
      remote: sekigon-gonnoc
      revision: main
    - name: zmk-feature-non-lipo-battery-management
      remote: sekigon-gonnoc
      revision: main
    - name: zmk-ws2812-driver
      remote: gohanda11
      revision: main
    - name: zmk-feature-xy_clipper
      remote: iwk7273
      revision: main
    - name: zmk-layout-shift
      remote: kot149
      revision: v1
    - name: zmk-feature-sensor_rotation
      remote: hsgw
      revision: main
      path: modules/zmk-feature-sensor_rotation
    - name: zmk-input-processor-temp-layer-threshold
      remote: yamaryu211
      revision: main
  self:
    path: config
```

## dts/bindings/zmk,input-processor-temp-layer-threshold.yaml
```yaml
# Copyright (c) 2024 The ZMK Contributors
# SPDX-License-Identifier: MIT

description: |
  Temporary layer input processor with a cumulative movement threshold.
  The target layer is activated only after relative movement reaches the
  configured threshold within reset-timeout-ms.

compatible: "zmk,input-processor-temp-layer-threshold"

properties:
  "#input-processor-cells":
    type: int
    required: true
    const: 2

  track-remainders:
    type: boolean

  threshold:
    type: int
    default: 0
    description: Cumulative relative movement required before activation

  require-prior-idle-ms:
    type: int
    default: 0
    description: Milliseconds without a key press required before activation

  excluded-positions:
    type: array
    default: []
    description: Key positions which do not deactivate the temporary layer

  reset-timeout-ms:
    type: int
    default: 200
    description: Inactivity interval which resets accumulated movement

input-processor-cells:
  - param1
  - param2
```
